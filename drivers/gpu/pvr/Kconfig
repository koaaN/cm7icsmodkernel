## drivers/gpu/pvr/Kconfig
```kconfig
config SGX540
	tristate "PowerVR SGX"
	depends on ARCH_S5PV210
	---help---
	  Support for the PowerVR SGX 3D core.

choice
	prompt "PowerVR build type"
	depends on SGX540
	default SGX_540_BUILD_RELEASE

config SGX_540_BUILD_RELEASE
       bool "SGX540 RELEASE"

config SGX_540_BUILD_DEBUG
       bool "SGX540 DEBUG"

endchoice

config SGX_PDUMP
	depends on SGX530 || SGX540
	bool "PowerVR SGX Parameter Dump"
	---help---
	  This option enables the PDump (Parameter Dump) build to debug
	  the SGX driver. The user side of the driver must be built with
	  this option enabled as well
```

## drivers/media/video/samsung/fc8100/Kconfig
```kconfig
#
# Configuration for nmi_hw (ISDB-T)
#
#Derek: porting the fc8100 driver:2010.07.28
config ISDBT_FC8100
	bool "Samsung ISDB-T FC8100 Driver" 
	default n
	---help---
	  This is a ISDB-T for FC8100 Driver.
```
